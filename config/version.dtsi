#define VERSION_MACRO
macro_ver: macro_ver {
compatible = "zmk,behavior-macro";
label = "macro_ver";
#binding-cells = <0>;
bindings = <&kp N2>, <&kp N0>, <&kp N2>, <&kp N4>, <&kp N0>, <&kp N4>, <&kp N1>, <&kp N4>, <&kp MINUS>, <&kp N>, <&kp E>, <&kp O>, <&kp Q>, <&kp MINUS>, <&kp N9>, <&kp A>, <&kp N1>, <&kp N6>, <&kp N2>, <&kp N5>, <&kp D>, <&kp RET>;
};
